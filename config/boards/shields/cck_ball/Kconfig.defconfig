## config/boards/shields/cck_ball/Kconfig.defconfig
```kconfig
if SHIELD_CCK_BALL_RIGHT

config ZMK_KEYBOARD_NAME
	default "WK CCK BALL 5x6"

config ZMK_SPLIT_BLE_ROLE_CENTRAL
	default y

endif

if SHIELD_CCK_BALL_LEFT || SHIELD_CCK_BALL_RIGHT

config ZMK_SPLIT
	default y

endif
```

## config/boards/shields/cck_ball_ota/Kconfig.defconfig
```kconfig
if SHIELD_CCK_BALL_OTA_RIGHT

config ZMK_KEYBOARD_NAME
	default "CCK BALL OTA"

config ZMK_SPLIT_BLE_ROLE_CENTRAL
	default y

endif

if SHIELD_CCK_BALL_OTA_LEFT || SHIELD_CCK_BALL_OTA_RIGHT

config ZMK_SPLIT
	default y

endif
```

## config/boards/shields/cck_ball_ota/Kconfig.shield
```kconfig
config SHIELD_CCK_BALL_OTA_LEFT
    def_bool $(shields_list_contains,cck_ball_ota_left)

config SHIELD_CCK_BALL_OTA_RIGHT
    def_bool $(shields_list_contains,cck_ball_ota_right)
```

## config/west.yml
```yaml
manifest:
  remotes:
    - name: zmkfirmware
      url-base: https://github.com/zmkfirmware
    - name: DoctorWangWang
      url-base: https://github.com/DoctorWangWang
    - name: badjeff
      url-base: https://github.com/badjeff
  projects:
    - name: zmk
      remote: zmkfirmware
      revision: v0.3.0
      import: app/west.yml
    - name: zmk-pmw3610-driver
      remote: badjeff
      revision: main
    - name: mcuboot
      url: https://github.com/zephyrproject-rtos/mcuboot
      revision: v2.0.0
      path: bootloader/mcuboot
  #    - name: zmk-pmw3610-driver
  #      remote: DoctorWangWang
  #      revision: main

  self:
    path: config
```
